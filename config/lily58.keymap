// Copyright 2021 Manna Harbour
// https://github.com/manna-harbour/miryoku

#include "../miryoku/custom_config.h"
#include "../miryoku/mapping/58/lily58.h"
#include "../miryoku/miryoku.dtsi"

/ {
  macros {
    ntil: ntil {
      compatible = "zmk,behavior-macro";
      #binding-cells = <0>;
      bindings =
        <&macro_press &kp LALT>,
        <&macro_tap &kp N>,
        <&macro_release &kp LALT>,
        <&macro_tap &kp N>;
    };
  };
};
